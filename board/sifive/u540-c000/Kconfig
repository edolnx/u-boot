## board/sifive/u540-c000/Kconfig
```kconfig
if TARGET_U540_C000

config SYS_CPU
	default "u540"

config SYS_BOARD
	default "u540-c000"

config SYS_VENDOR
	default "sifive"

config SYS_SOC
	default "c000"

config SYS_CONFIG_NAME
	default "u540-c000"

config ENV_SIZE
	default 0x2000 if ENV_IS_IN_SPI_FLASH

config ENV_OFFSET
	default 0x140000 if ENV_IS_IN_SPI_FLASH

endif
```

## configs/u540-c000_defconfig
```kconfig
CONFIG_RISCV=y
CONFIG_SYS_TEXT_BASE=0x80000000
CONFIG_TARGET_U540_C000=y
CONFIG_CPU_RISCV_64=y
CONFIG_DISTRO_DEFAULTS=y
CONFIG_NR_DRAM_BANKS=1
CONFIG_BOOTDELAY=3
CONFIG_SYS_PROMPT="hifive_unleashed => "
CONFIG_OF_BOARD=y
```
